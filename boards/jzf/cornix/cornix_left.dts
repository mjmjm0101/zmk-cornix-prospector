/*
 * Copyright (c) 2020 Pete Johanson
 *
 * SPDX-License-Identifier: MIT
 */

/dts-v1/;
#include "cornix_left_common.dtsi"

/*
 * Battery calibration (LEFT half). See README.md "Battery calibration".
 * Nominal full-ohms is 2806000. Lower = reports lower %, higher = higher %.
 *
 * Current value: 2806000 (nominal, same as right).
 * History: 2026-05-31 trimmed to 2783000 (~-0.8%) because the left half
 * read ~34 mV high at full charge and pinned at the 100% clamp. That trim
 * then left the half topping out at ~99%, so on 2026-10-15 it was reverted
 * to nominal to re-observe the behaviour. Re-trim here if 100% pinning
 * returns (see README for the procedure).
 */
&vbatt {
    full-ohms = <2806000>;
};

// vim: set ft=dts: